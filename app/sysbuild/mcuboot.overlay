/*
 * MCUboot devicetree overlay (auto-applied by sysbuild to the mcuboot image).
 * Enable the onboard MX25R64 SPI-NOR and select it as the Partition Manager
 * external-flash device so MCUboot can read/swap the secondary slot off-chip.
 */

&mx25r64 {
	status = "okay";
};

/ {
	chosen {
		nordic,pm-ext-flash = &mx25r64;
	};
};
